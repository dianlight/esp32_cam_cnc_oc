## components/idf_arduino_ota/Kconfig
```kconfig
menu "Arduino OTA Configuration"

    config ARDUINO_OTA_TRIGGER_PORT
        int "Port where receive OTA invitation"
        default 8032
        help
            Port where receive OTA invitation

    config ARDUINO_OTA_SKIP_VERSION_CHECK
        bool "Skip firmware version check"
        default n
        help
            This allows you to skip the firmware version check.

    config ARDUINO_OTA_RECV_TIMEOUT
        int "OTA Receive Timeout"
        default 5000
        help
            Maximum time for reception

endmenu
```

## components/udp_logging/Kconfig
```kconfig
menu "UDP Logging"

config UDP_LOG_SUPPORT
    bool "Send log to UDP after Network UP"
    default y
    help
    Enable this option if you want to use the UDP log trasmission.
    Disable this option to log on serial port.

choice UDP_LOG_MODE
    bool "Working mode for UDP_LOG"
    default UDP_LOG_MIRROR_MODE
    help
        udp_logging can work in different way. Choose any one.

    config UDP_LOG_MIRROR_MODE
        bool "Always mirror on fallback logger"
    config UDP_LOG_FALLBACK_MODE
        bool "Send to fallback logger if not connect"
    config UDP_LOG_ONLY_MODE
        bool "Drop log if not connect"
endchoice

config UDP_LOG_MODE
    int
    default 1 if UDP_LOG_MIRROR_MODE
    default 2 if UDP_LOG_FALLBACK_MODE
    default 3 if UDP_LOG_ONLY_MODE


config LOG_UDP_PORT
    int "UDP Port" 
    default 16666
    depends on UDP_LOG_SUPPORT
    help
        UDP Port to send log output to

config LOG_UDP_IP
    string "IP address to send log output"
	default "192.168.0.255"
	help
		IP address to send log output to
endmenu
```

## components/wifi_prov_mgr/Kconfig
```kconfig
menu "Wi-Fi Auto Configurator"

config MDNS_HOSTNAME
    string "mDNS Hostname"
    default ESP32DEV
    help
        mDNS Hostname for example to use

config MDNS_ADD_MAC_TO_HOSTNAME
    bool "Add mac suffix to hostname"
    default n
    help
        If enabled, a portion of MAC address is added to the hostname, this is used
        for evaluation of tests in CI


choice PROV_TRANSPORT
    bool "Provisioning Transport"
    default PROV_TRANSPORT_SOFTAP
    help
        Wi-Fi provisioning component offers both, SoftAP and BLE transports. Choose any one.

    config PROV_TRANSPORT_BLE
        bool "BLE"
        select BT_ENABLED
        depends on IDF_TARGET_ESP32
    config PROV_TRANSPORT_SOFTAP
        bool "Soft AP"
endchoice

config PROV_TRANSPORT
    int
    default 1 if PROV_TRANSPORT_BLE
    default 2 if PROV_TRANSPORT_SOFTAP

config PROV_WIFI_AP
    string "Wifi SoftAP Name"
    default ESP_CONFIG
    depends on PROV_TRANSPORT_SOFTAP
    help
        SoftAP name


endmenu
```

## src/Kconfig.projbuild
```kconfig
menu "Grbl COFC configuration"

  menu "Virtual Serial Config"

    config TCP_SERIAL_SUPPORT
      bool "Support Virtual Serial on TCP Connection"
      default y
      help
        Enable this option if you want to use the TCP virtual serial.
        Disable this option to save memory.
    
    config TCP_SERIAL_PORT
      int "TCP Port"
      default "3244"
      depends on TCP_SERIAL_SUPPORT
      help
        The TCP/IP port where serial is exposed
        
    config BLUETOOTH_SERIAL_SUPPORT
      bool "Support Virtual Serial on SPP / Bluetooth Connection"
      default y
      depends on BT_ENABLED
      help
        Enable this option if you want to use the Bluetooth SPP virtual serial.
        Disable this option to save memory.


   


  endmenu

  menu "Camera configuration"

    config XCLK_FREQ
      int "XCLK Frequency"
      default "20000000"
      help
        The XCLK Frequency in Herz.
          
    menu "Pin Configuration"
      config D0
        int "D0"
        default "5"
      config D1
        int "D1"
        default "18"
      config D2
        int "D2"
        default "19"
      config D3
        int "D3"
        default "21"
      config D4
        int "D4"
        default "36"
      config D5
        int "D5"
        default "39"
      config D6
        int "D6"
        default "34"
      config D7
        int "D7"
        default "35"
      config XCLK
        int "XCLK"
        default "0"
      config PCLK
        int "PCLK"
        default "22"
      config VSYNC
        int "VSYNC"
        default "25"
      config HREF
        int "HREF"
        default "23"
      config SDA
        int "SDA"
        default "26"
      config SCL
        int "SCL"
        default "27"
      config RESET
        int "RESET"
        default "-1"
      config PWDN
        int "PWDN"
        default "32"
    endmenu

    config OV2640_SUPPORT
      bool "OV2640 Support"
      default y
      help
        Enable this option if you want to use the OV2640.
        Disable this option to save memory.

    config OV7725_SUPPORT
      bool "OV7725 Support"
      default n
      help
        Enable this option if you want to use the OV7725.
        Disable this option to save memory.

    config OV3660_SUPPORT
      bool "OV3660 Support"
      default n
      help
        Enable this option if you want to use the OV3360.
        Disable this option to save memory.

    config OV5640_SUPPORT
      bool "OV5640 Support"
      default n
      help
        Enable this option if you want to use the OV5640.
        Disable this option to save memory.

    choice CAMERA_TASK_PINNED_TO_CORE
      bool "Camera task pinned to core"
      default CAMERA_CORE0
      help
        Pin the camera handle task to a certain core(0/1). It can also be done automatically choosing NO_AFFINITY.

      config CAMERA_CORE0
        bool "CORE0"
      config CAMERA_CORE1
        bool "CORE1"
      config CAMERA_NO_AFFINITY
        bool "NO_AFFINITY"

    endchoice

  endmenu
	
endmenu
```
